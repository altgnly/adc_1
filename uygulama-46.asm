	LIST P=16F877A
	#INCLUDE <P16F877A.INC>
	__CONFIG H'3F31'
	SAYICI1 EQU 0X20
	SAYICI2 EQU 0X21

	ORG 0X00
	GOTO ANA_METOT
	
ANA_METOT
	BANKSEL PORTB
	CLRF PORTB
	CLRF PORTC

	BANKSEL TRISB
	CLRF TRISB
	CLRF TRISC
	MOVLW 0XFF
	MOVWF TRISE

	MOVLW B'10000000'
	MOVWF ADCON1

	BANKSEL ADCON0
	MOVLW B'11101001'
	MOVWF ADCON0
	CALL GECIKME
	BANKSEL ADCON0

DONUSTURME_METOT
	BANKSEL ADCON0
	BSF ADCON0,GO
	CALL GECIKME

KONTROL
	BTFSC ADCON0,GO
	GOTO KONTROL

YAZDIR
	BANKSEL ADRESH
	MOVF ADRESH,W
	MOVWF PORTC

	BANKSEL ADRESL
	MOVF ADRESL,W
	BANKSEL PORTB
	MOVWF PORTB

	GOTO DONUSTURME_METOT

GECIKME	
	MOVLW 0XA0
	MOVWF SAYICI1

TEKRAR1
	MOVLW 0XA0
	MOVWF SAYICI2

TEKRAR2
	DECFSZ SAYICI2,F
	GOTO TEKRAR2
	DECFSZ SAYICI1,F
	GOTO TEKRAR1
	RETURN

END